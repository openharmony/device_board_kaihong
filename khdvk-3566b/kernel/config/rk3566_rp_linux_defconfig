## khdvk-3566b/kernel/vendor/drivers/Kconfig
```kconfig
# SPDX-License-Identifier: GPL-2.0
config VENDOR_KHDVK_3566B_DRIVER_VIDEO
	bool "boars Device drivers video"
	default y
if VENDOR_KHDVK_3566B_DRIVER_VIDEO
source "vendor/drivers/video/Kconfig"
endif


config VENDOR_KHDVK_3566B_DRIVER_PHY
	bool "boars Device drivers phy"
	default y
if VENDOR_KHDVK_3566B_DRIVER_PHY
source "vendor/drivers/phy/Kconfig"
endif


config VENDOR_KHDVK_3566B_DRIVER_DMA_BUF
	bool "boars Device drivers dam buf"
	default y
if VENDOR_KHDVK_3566B_DRIVER_DMA_BUF
source "vendor/drivers/dma-buf/Kconfig"
endif

config VENDOR_KHDVK_3566B_DRIVER_MEDIA
	bool "boars Device drivers media"
	default y
if VENDOR_KHDVK_3566B_DRIVER_MEDIA
source "vendor/drivers/media/Kconfig"
endif

config VENDOR_KHDVK_3566B_DRIVER_WIRELESS
	bool "boars Device drivers wireless"
	default y


if VENDOR_KHDVK_3566B_DRIVER_WIRELESS
source "vendor/drivers/wireless/Kconfig"
endif

config VENDOR_KHDVK_3566B_DRIVER_GPIO
	bool "boars Device drivers gpio"
	default y

if VENDOR_KHDVK_3566B_DRIVER_GPIO
source "vendor/drivers/gpio/Kconfig"
endif


config VENDOR_KHDVK_3566B_DRIVER_NET
	bool "boars Device drivers net"
	default y

if VENDOR_KHDVK_3566B_DRIVER_NET
source "vendor/drivers/net/Kconfig"
endif

config VENDOR_KHDVK_3566B_DRIVER_FIRMWARE
	bool "VENDOR RK3566 FIRMWARE"
	default y
source "vendor/drivers/firmware/Kconfig"
```

## khdvk-3566b/kernel/vendor/drivers/dma-buf/Kconfig
```kconfig
menu "VENDOR DMABUF options"

config VENDOR_DMABUF_HEAPS
     bool "DMA BUF HEAPS Drivers"
     default y
#	 select DMA_SHARED_BUFFER

source "vendor/drivers/dma-buf/heaps/Kconfig"

endmenu
```

## khdvk-3566b/kernel/vendor/drivers/firmware/Kconfig
```kconfig
# SPDX-License-Identifier: GPL-2.0-only
#
# For a description of the syntax of this configuration file,
# see Documentation/kbuild/kconfig-language.rst.
#

config VENDOR_KHDVK_3566B_DRIVER_ROCKCHIP_SIP
	tristate "Rockchip SIP interface"
	depends on HAVE_ARM_SMCCC && ARCH_ROCKCHIP
	help
	  Say Y here if you want to enable SIP callbacks for Rockchip platforms
	  This option enables support for communicating with the ATF.
```

## khdvk-3566b/kernel/vendor/drivers/net/ethernet/Kconfig
```kconfig
config VENDOR_KHDVK_3566B_DRIVER_NET_TOOL
	bool "rk3566 Device drivers tool"
	default y
```

## khdvk-3566b/kernel/vendor/drivers/video/Kconfig
```kconfig
# SPDX-License-Identifier: GPL-2.0-only
#
# Video configuration
#

menu "Rockchip Misc Video driver"
source "vendor/drivers/video/rockchip/Kconfig"
endmenu

source "vendor/drivers/gpu/arm/Kconfig"
```

## khdvk-3566b/kernel/vendor/drivers/video/rockchip/Kconfig
```kconfig
# SPDX-License-Identifier: GPL-2.0
source "vendor/drivers/video/rockchip/rga2/Kconfig"
source "vendor/drivers/video/rockchip/mpp/Kconfig"
```

## khdvk-3566b/kernel/vendor/rk3566/cpufreq/Kconfig
```kconfig
config ARM_ROCKCHIP_CPUFREQ
	tristate "Rockchip CPUfreq driver"
	depends on ARCH_ROCKCHIP && CPUFREQ_DT
	select PM_OPP
	help
	  This adds the CPUFreq driver support for Rockchip SoCs,
	  based on cpufreq-dt.

	  If in doubt, say N.
```

## khdvk-3566b/kernel/vendor/rk3566/regulator/Kconfig
```kconfig
# SPDX-License-Identifier: GPL-2.0-only
config REGULATOR_XZ3216
	tristate "Xizhuo XZ3216 voltage regulator"
	depends on I2C
	help
	  Support the voltage and current regulators of the XZ321X series of DCDC devices.
```

## khdvk_3566b/kernel/touchscreen/Kconfig
```kconfig
config DRIVERS_HDF_INPUT
    bool "Enable HDF input driver"
    default n
    depends on DRIVERS_HDF
    help
      Answer Y to enable HDF input driver.

config DRIVERS_HDF_TP_5P5_GT911
    bool "Enable HDF tp 5P5 GT911 driver"
    default n
    depends on DRIVERS_HDF_INPUT
    help
      Answer Y to enable HDF TP 5P5 GT911 driver.

config DRIVERS_HDF_TP_2P35_FT6236
    bool "Enable HDF tp 2P35 FT6236 driver"
    default n
    depends on DRIVERS_HDF_INPUT
    help
      Answer Y to enable HDF TP 2P35 FT6236 driver.

config DRIVERS_HDF_INPUT_INFRARED
    bool "Enable HDF infrared driver"
    default n
    depends on DRIVERS_HDF_INPUT
    help
      Answer Y to enable HDF infrared driver.

config DRIVERS_HDF_TP_5P43_FT5406
    bool "Enable HDF tp 5P43 FT5406 driver"
    default n
    depends on DRIVERS_HDF_INPUT
    help
      Answer Y to enable HDF TP 5P43 FT5406 driver.
      
config ARCH_NXP_TOUCH
    bool "Enable HDF tp nxp ft5x06 touch"
    default n
    depends on DRIVERS_HDF_INPUT
    help
      Answer Y to enable HDF TP nxp ft5x06 touch.
```

## khdvk_3566b/kernel/vendor/Kconfig
```kconfig
# SPDX-License-Identifier: GPL-2.0

config VENDOR_KHDVK_3566B_DRIVER
	bool "vendor board drivers"
	default y
config VENDOR_RK3566_DRIVER
	bool "vendor soc drivers"
	default y

menu "Vendor Drivers"
if VENDOR_KHDVK_3566B_DRIVER
source "vendor/drivers/Kconfig"
endif

if VENDOR_RK3566_DRIVER
source "vendor/rk3566/Kconfig"
endif

endmenu
```

## khdvk_3566b/kernel/vendor/drivers/dma-buf/heaps/Kconfig
```kconfig
config VENDOR_DMABUF_HEAPS_DEFERRED_FREE
	bool "Vendor DMA-BUF heaps deferred-free library"
	default y
	help
	  Choose this option to enable the DMA-BUF heaps deferred-free library.

config VENDOR_DMABUF_HEAPS_PAGE_POOL
	bool "Vendor DMA-BUF heaps page-pool library"
	default y
	help
	  Choose this option to enable the DMA-BUF heaps page-pool library.
```

## khdvk_3566b/kernel/vendor/drivers/gpio/Kconfig
```kconfig
# SPDX-License-Identifier: GPL-2.0-only
#
# GPIO infrastructure and drivers
#

config VENDOR_GPIO_ROCKCHIP
	tristate "Rockchip GPIO support"
	depends on ARCH_ROCKCHIP || COMPILE_TEST
	select GPIOLIB_IRQCHIP
	default ARCH_ROCKCHIP
	help
	  Say yes here to support GPIO on Rockchip SoCs.
```

## khdvk_3566b/kernel/vendor/drivers/media/Kconfig
```kconfig
# SPDX-License-Identifier: GPL-2.0-only
# 
# Vendor Multimedia device configuration
#
source "vendor/drivers/media/i2c/Kconfig"
source "vendor/drivers/media/platform/Kconfig"
```

## khdvk_3566b/kernel/vendor/drivers/media/i2c/Kconfig
```kconfig
# SPDX-License-Identifier: GPL-2.0-only
#
# Multimedia Video device configuration
#
#
# V4L2 I2C drivers that are related with Camera support
#

config VENDOR_VIDEO_GC2093
	bool "GalaxyCore GC2093 sensor support"
	default y
```

## khdvk_3566b/kernel/vendor/drivers/media/platform/Kconfig
```kconfig
# SPDX-License-Identifier: GPL-2.0-only
#
# Platform drivers
#	Most drivers here are currently for webcam support

menuconfig V4L_PLATFORM_DRIVERS

if V4L_PLATFORM_DRIVERS

source "vendor/drivers/media/platform/rockchip/cif/Kconfig"
source "vendor/drivers/media/platform/rockchip/isp/Kconfig"
source "vendor/drivers/media/platform/rockchip/ispp/Kconfig"

endif # V4L_PLATFORM_DRIVERS
```

## khdvk_3566b/kernel/vendor/drivers/net/Kconfig
```kconfig
source "vendor/drivers/net/ethernet/Kconfig"
source "vendor/drivers/net/usb/Kconfig"
```

## khdvk_3566b/kernel/vendor/drivers/net/usb/Kconfig
```kconfig
config VENDOR_KHDVK_3566B_DRIVER_NET_USB
	bool "rk3566 Device drivers usb"
	default y
```

## khdvk_3566b/kernel/vendor/drivers/phy/Kconfig
```kconfig
# SPDX-License-Identifier: GPL-2.0-only
#
# Phy vendor drivers for Rockchip platforms
#
config PHY_ROCKCHIP_CSI2_DPHY
	tristate "Rockchip CSI2 D-PHY Driver"
	depends on VIDEO_V4L2 && VIDEO_V4L2_SUBDEV_API
	depends on ARCH_ROCKCHIP && OF
	select GENERIC_PHY
	help
	  Enable this to support the Rockchip CSI2 DPHY.

config PHY_ROCKCHIP_INNO_COMBPHY
	tristate "Rockchip INNO USB 3.0 and PCIe COMBPHY Driver"
	depends on (ARCH_ROCKCHIP && OF) || COMPILE_TEST
	select GENERIC_PHY
	help
	  Enable this to support the Rockchip SoCs COMBPHY.
	  If unsure, say N.

config PHY_ROCKCHIP_INNO_USB3
	tristate "Rockchip INNO USB 3.0 PHY Driver"
	depends on (ARCH_ROCKCHIP || COMPILE_TEST) && OF
	select GENERIC_PHY
	select USB_PHY
	help
	  Support for Rockchip USB 3.0 PHY with Innosilicon IP block.

config PHY_ROCKCHIP_MIPI_RX
	tristate "Rockchip MIPI RX D-PHY Driver"
	depends on VIDEO_V4L2 && VIDEO_V4L2_SUBDEV_API
	depends on ARCH_ROCKCHIP && OF
	select GENERIC_PHY
	help
	  Enable this to support the Rockchip MIPI D-PHY with Synopsys or Innosilicon IP block.

config PHY_ROCKCHIP_NANENG_COMBO_PHY
	tristate "Rockchip NANENG COMBO PHY Driver"
	depends on ARCH_ROCKCHIP && OF
	select GENERIC_PHY
	help
	  Enable this to support the Rockchip PCIe/USB3.0/SATA/QSGMII
	  combo PHY with NaNeng IP block.

config PHY_ROCKCHIP_NANENG_EDP
	tristate "Rockchip Naneng eDP Transmitter PHY driver"
	depends on ARCH_ROCKCHIP && OF
	select GENERIC_PHY
	help
	  Support for Rockchip eDP Transmitter PHY with Naneng IP block.

config PHY_ROCKCHIP_NANENG_USB2
	tristate "Rockchip NANENG USB2PHY Driver"
	depends on (ARCH_ROCKCHIP || COMPILE_TEST) && OF
	depends on COMMON_CLK
	select EXTCON
	depends on USB_SUPPORT
	select GENERIC_PHY
	select USB_COMMON
	help
	  Support for Rockchip USB2.0 PHY with NANENG IP block.

config PHY_ROCKCHIP_SAMSUNG_DCPHY
	tristate "Rockchip Samsung MIPI DCPHY driver"
	depends on (ARCH_ROCKCHIP || COMPILE_TEST) && OF
	select GENERIC_PHY
	select GENERIC_PHY_MIPI_DPHY
	help
	  Enable this to support the Rockchip MIPI DCPHY with
	  Samsung IP block.

config PHY_ROCKCHIP_SAMSUNG_HDPTX
	tristate "Rockchip Samsung HDMI/DP Combo PHY driver"
	depends on OF && (ARCH_ROCKCHIP || COMPILE_TEST)
	select GENERIC_PHY
	help
	  Support for Rockchip HDMI/DP Combo PHY with Samsung IP block.

config PHY_ROCKCHIP_SAMSUNG_HDPTX_HDMI
	tristate "Rockchip Samsung HDMI/DP Combo PHY HDMI driver"
	depends on OF && (ARCH_ROCKCHIP || COMPILE_TEST)
	select GENERIC_PHY
	help
	  Support for Rockchip HDMI/DP Combo PHY with Samsung IP block.

config PHY_ROCKCHIP_SNPS_PCIE3
	tristate "Rockchip Snps PCIe3 PHY Driver"
	depends on (ARCH_ROCKCHIP && OF) || COMPILE_TEST
	depends on HAS_IOMEM
	select GENERIC_PHY
	select MFD_SYSCON
	help
	  Enable this to support the Rockchip snps PCIe3 PHY.

config PHY_ROCKCHIP_USBDP
	tristate "Rockchip USBDP COMBO PHY Driver"
	depends on ARCH_ROCKCHIP && OF
	select GENERIC_PHY
	select TYPEC
	help
	  Enable this to support the Rockchip USB3.0/DP
	  combo PHY with Samsung IP block.
```

## khdvk_3566b/kernel/vendor/drivers/wireless/Kconfig
```kconfig
# SPDX-License-Identifier: GPL-2.0-only
#
# Wireless LAN device configuration
#

config VENDOR_WL_ROCKCHIP
	bool "VENDOR RK3566 WL RK3566"
	default y
```

## khdvk_3566b/kernel/vendor/rk3566/Kconfig
```kconfig
#
# rk3566 driver configuration
#

config VENDOR_RK3566_DRIVER_MMC
	bool "rk3566 soc drivers mmc"
	default y
if VENDOR_RK3566_DRIVER_MMC
source "vendor/rk3566/mmc/Kconfig"
endif

config VENDOR_RK3566_DRIVER_REGULATOR
	bool "rk3566 soc drivers regulator"
	default y
if VENDOR_RK3566_DRIVER_REGULATOR
source "vendor/rk3566/regulator/Kconfig"
endif

config VENDOR_RK3566_DRIVER_PCI
	bool "rk3566 soc drivers pci"
	default y
if VENDOR_RK3566_DRIVER_PCI
source "vendor/rk3566/pci/Kconfig"
endif

config VENDOR_RK3566_DRIVER_INPUT
	bool "rk3566 soc drivers input"
	default y
if VENDOR_RK3566_DRIVER_INPUT
source "vendor/rk3566/input/Kconfig"
endif

config VENDOR_RK3566_DRIVER_STAGING
	bool "rk3566 soc drivers staging"
	default y
if VENDOR_RK3566_DRIVER_STAGING
source "vendor/rk3566/staging/Kconfig"
endif

config VENDOR_RK3566_DRIVER_NET
	bool "rk3566 soc drivers net"
	default y
if VENDOR_RK3566_DRIVER_NET
source "vendor/rk3566/net/Kconfig"
endif

config VENDOR_RK3566_DRIVER_DEVFREG
	bool "rk3566 soc drivers cpu dev freg"
	default y
if VENDOR_RK3566_DRIVER_DEVFREG
source "vendor/rk3566/devfreq/Kconfig"
endif

config VENDOR_RK3566_DRIVER_CPUFINFO
	bool "rk3566 soc drivers cpu info"
	default y
if VENDOR_RK3566_DRIVER_CPUFINFO
source "vendor/rk3566/rockchip/Kconfig"
endif

config VENDOR_RK3566_DRIVER_CPUFRQ
	bool "rk3566 soc drivers cpufreg"
	default y
if VENDOR_RK3566_DRIVER_CPUFRQ
source "vendor/rk3566/cpufreq/Kconfig"
endif

config VENDOR_RK3566_DRIVER_CLK
	bool "rk3566 soc drivers clk"
	default y
if VENDOR_RK3566_DRIVER_CLK
source "vendor/rk3566/clk/Kconfig"
endif

config VENDOR_RK3566_DRIVER_POWER
	bool "Vendor Power Drivers"
	default y

source "vendor/rk3566/power/Kconfig"
```

## khdvk_3566b/kernel/vendor/rk3566/clk/Kconfig
```kconfig
# SPDX-License-Identifier: GPL-2.0
# common clock support for ROCKCHIP SoC family.

if VENDOR_RK3566_DRIVER_CLK
config CLK_RV1126
	tristate "Rockchip RV1126 clock controller support"
	depends on ARM || COMPILE_TEST
	default y
	help
	  Build the driver for RV1126 Clock Driver.

config CLK_RK1808
	tristate "Rockchip RK1808 clock controller support"
	depends on ARM64 || COMPILE_TEST
	default y
	help
	  Build the driver for RK1808 Clock Driver.

config CLK_RK3568
	tristate "Rockchip RK3568 clock controller support"
	depends on ARM64 || COMPILE_TEST
	default y
	help
	  Build the driver for RK3568 Clock Driver.
endif
```

## khdvk_3566b/kernel/vendor/rk3566/devfreq/Kconfig
```kconfig
config ARM_ROCKCHIP_BUS_DEVFREQ
	tristate "ARM ROCKCHIP BUS DEVFREQ Driver"
	depends on ARCH_ROCKCHIP
	help
	  This adds the DEVFREQ driver for the ROCKCHIP BUS.

config ARM_ROCKCHIP_DMC_DEVFREQ
	tristate "ARM ROCKCHIP DMC DEVFREQ Driver"
	depends on (ARCH_ROCKCHIP && HAVE_ARM_SMCCC) || \
		(COMPILE_TEST && HAVE_ARM_SMCCC)
	select DEVFREQ_EVENT_ROCKCHIP_DFI
	select PM_DEVFREQ_EVENT
	help
	  This adds the DEVFREQ driver for the ROCKCHIP DMC(Dynamic Memory Controller).
	  It sets the frequency for the memory controller and reads the usage counts
	  from hardware.

source "vendor/rk3566/devfreq/event/Kconfig"
```

## khdvk_3566b/kernel/vendor/rk3566/devfreq/event/Kconfig
```kconfig
config DEVFREQ_EVENT_ROCKCHIP_NOCP
	tristate "ROCKCHIP NoC (Network On Chip) Probe DEVFREQ event Driver"
	depends on ARCH_ROCKCHIP
	help
	  This add the devfreq-event driver for Rockchip SoC. It provides NoC
	  (Network on Chip) Probe counters to monitor traffic statistics.
```

## khdvk_3566b/kernel/vendor/rk3566/mmc/Kconfig
```kconfig
config VENDOR_RK3566_DRIVER_MMC_HOST
     bool "MMC HOST Drivers"
     default y

source "vendor/rk3566/mmc/host/Kconfig"
```
